## 3 ano/1 Semestre/DC/P/08/Exemplos de MQTT/mqtt_ssl/main/Kconfig.projbuild
```kconfig
menu "Example Configuration"

    config BROKER_URI
        string "Broker URL"
        default "mqtts://test.mosquitto.org:8883"
        help
            URL of an mqtt broker which this example connects to.

    config BROKER_CERTIFICATE_OVERRIDE
        string "Broker certificate override"
        default ""
        help
            Please leave empty if broker certificate included from a textfile; otherwise fill in a base64 part of PEM
            format certificate

    config BROKER_CERTIFICATE_OVERRIDDEN
        bool
        default y if BROKER_CERTIFICATE_OVERRIDE != ""

endmenu

menu "EcoNode"

    config NODE_ID
        int "node_id do grupo (1000 + 10 x turma + grupo)"
        range 1000 9999
        default 1000
        help
            Identificador do nó, usado na base dos tópicos econode/<node_id>/.

endmenu
```

## 3 ano/1 Semestre/DC/P/08/Exemplos de MQTT/mqtt_tcp/main/Kconfig.projbuild
```kconfig
menu "Example Configuration"

    config BROKER_URL
        string "Broker URL"
        default "mqtt://test.mosquitto.org"
        help
            URL of the broker to connect to

    config BROKER_URL_FROM_STDIN
        bool
        default y if BROKER_URL = "FROM_STDIN"

endmenu

menu "EcoNode"

    config NODE_ID
        int "node_id do grupo (1000 + 10 x turma + grupo)"
        range 1000 9999
        default 1000
        help
            Identificador do nó, usado na base dos tópicos econode/<node_id>/.

endmenu
```
